## soc/snps/nsim/arc_v/rhx/Kconfig.defconfig
```kconfig
# Copyright (c) 2024 Synopsys, Inc.
# SPDX-License-Identifier: Apache-2.0

if SOC_SERIES_RHX

config SYS_CLOCK_HW_CYCLES_PER_SEC
	default $(dt_node_int_prop_int,/cpus/cpu@0,clock-frequency)

config NUM_IRQS
	default 32

config PMP_SLOTS
	default 32

config PMP_GRANULARITY
	default 32

config MAX_DOMAIN_PARTITIONS
	default 32 if USERSPACE

config RISCV_PMP
	default y

config RISCV_SOC_INTERRUPT_INIT
	default y

endif # SOC_SERIES_RHX
```

## soc/snps/nsim/arc_v/rmx/Kconfig
```kconfig
# Copyright (c) 2024 Synopsys, Inc.
# SPDX-License-Identifier: Apache-2.0

config SOC_SERIES_RMX
	bool
	select RISCV
	select RISCV_PRIVILEGED
	select RISCV_SOC_HAS_GP_RELATIVE_ADDRESSING
	select RISCV_SMRNMI_ENABLE_NMI_DELIVERY
	select INCLUDE_RESET_VECTOR
	imply XIP

config SOC_RMX_UART_DEVICE_PMA
	bool "Mark the uart0 registers as device memory in the PMA"
	depends on SOC_SERIES_RMX
	depends on $(dt_nodelabel_enabled,uart0)
	select SOC_EARLY_INIT_HOOK
	help
	  Program PMA entry 0 at boot so that the uart0 register range is
	  device non-idempotent memory. Addresses without a PMA entry default
	  to normal cacheable memory, so the core may merge and buffer stores
	  to the UART registers and the UART setup is lost. Enable only on
	  cores configured with PMA entries, the PMA CSRs are illegal
	  otherwise.
```
